VERSION ""

NS_ :

BS_:

BU_:

BO_ 3221225472 VECTOR__INDEPENDENT_SIG_MSG: 0 Vector__XXX
 SG_ PTC_HvCur : 0|4@0+ (1,0) [0|15] "A" Vector__XXX
 SG_ PTC_HVin : 0|8@1+ (2,0) [0|510] "V" Vector__XXX

BO_ 694 Clnt_PTC_2: 8 Vector__XXX
 SG_ PTC_TempOut : 39|16@0+ (1,0) [0|65535] "" Vector__XXX
 SG_ PTC_TempIn : 23|16@0+ (1,0) [0|65535] "" Vector__XXX

BO_ 693 Clnt_PTC_1: 8 Vector__XXX

CM_ BO_ 3221225472 "This is a message for not used signals, created by Vector CANdb++ DBC OLE DB Provider.";
CM_ SG_ 694 PTC_TempOut "To be confirmed";
CM_ SG_ 694 PTC_TempIn "To be confirmed";
BA_DEF_  "BusType" STRING ;
BA_DEF_DEF_  "BusType" "CAN";
